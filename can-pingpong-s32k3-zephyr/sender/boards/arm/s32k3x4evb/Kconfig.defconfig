## can-pingpong-s32k3-zephyr/sender/boards/arm/s32k3x4evb/Kconfig.defconfig
```kconfig
# Copyright 2023-2024 NXP
# SPDX-License-Identifier: Apache-2.0

if BOARD_S32K3X4EVB

config BOARD
	default "s32k3x4evb"

if SERIAL

config UART_CONSOLE
	default y

endif # SERIAL

if SPI

config SPI_INIT_PRIORITY
	default 50

if WDT_NXP_FS26

config WDT_NXP_FS26_INIT_PRIORITY
	default 51

endif # WDT_NXP_FS26
endif # SPI

if NETWORKING

config NET_L2_ETHERNET
	default y if !NET_LOOPBACK && !NET_TEST

config MDIO
	default y if NET_L2_ETHERNET

endif # NETWORKING

endif # BOARD_S32K3X4EVB
```

## can-pingpong-s32k3-zephyr/sender/boards/arm/s32k3x4evb/Kconfig.s32k3x4evb
```kconfig
# Copyright 2023-2024 NXP
# SPDX-License-Identifier: Apache-2.0

config BOARD_S32K3X4EVB
	select SOC_S32K344
	select SOC_PART_NUMBER_PS32K344EHVPBS
```

## can-pingpong-s32k3-zephyr/sender/boards/arm/s32k3x4evb/board.yml
```yaml
board:
  name: s32k3x4evb
  full_name: NXP S32K3X4EVB-T172 Evaluation Board (ECUSim)
  vendor: nxp
  socs:
    - name: s32k344
```
